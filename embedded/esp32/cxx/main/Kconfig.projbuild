## embedded/esp32/cxx/main/Kconfig.projbuild
```kconfig
menu "SneakerNet"
    config SNEAKERNET_FILES_SUPPORT
        bool "Allow uncontrolled files"
        default n
        help
            Allow users to share files via the SneakerNet node.
            As these aren't ebooks their is no way to control this content.

    config SNEAKERNET_FILES_MAX_SIZE
        depends on SNEAKERNET_FILES_SUPPORT
        int "size in kilobytes for the files folder"
        default 1024
endmenu
```

## embedded/esp32/cxx/sdkconfig.defaults
```kconfig
# Required for connection redirect
CONFIG_HTTPD_MAX_REQ_HDR_LEN=1024

# FIXME TEST-USE-ONLY
CONFIG_SNEAKERNET_FILES_SUPPORT=y
CONFIG_SNEAKERNET_FILES_MAX_SIZE_KB=1024

# FIXME app is too big
CONFIG_ESPTOOLPY_FLASHSIZE_4MB=y
CONFIG_PARTITION_TABLE_SINGLE_APP_LARGE=y

# CONFIG_PARTITION_TABLE_TWO_OTA=y
# CONFIG_ESP_HTTPS_OTA_ALLOW_HTTP=y
```

## embedded/esp32/main/Kconfig.projbuild
```kconfig
menu "SneakerNet"
    config SNEAKERNET_CONTENT_ALLOW_NON_EPUB
        bool "Allow files that aren't epub documents"
        default y
        help
            Allow users to share files via the SneakerNet node.
            As these aren't ebooks their is no way to control this content.

    config SNEAKERNET_CONTENT_REQUIRE_SNEAKERNET_SIGNATURE
        bool "Require a sneakernet signature on epub documents"
        default n
        help
            Allows the librarian to ensure that epub content comes from
            accepted publishers.
endmenu
```

## embedded/esp32/sdkconfig.defaults
```kconfig
# Configure FATFS
    CONFIG_FATFS_VOLUME_COUNT=1
    CONFIG_FATFS_FAT16=y
    # support long filenames
    CONFIG_FATFS_LFN_HEAP=y
    CONFIG_FATFS_MAX_LFN=255
    CONFIG_FATFS_API_ENCODING_UTF_8=y

# Configure WebApi
    # Required for connection redirect
    CONFIG_HTTPD_MAX_REQ_HDR_LEN=1024
    # enable HTTPS
#    CONFIG_ESP_TLS_SERVER=y
#    CONFIG_ESP_HTTPS_SERVER_ENABLE=y

# ESP32 overrides
CONFIG_BOOTLOADER_COMPILER_OPTIMIZATION_PERF=y


## Configure partitions
#    # FIXME app is too big
#    CONFIG_ESPTOOLPY_FLASHSIZE_4MB=y
#    CONFIG_PARTITION_TABLE_SINGLE_APP_LARGE=y
#
#    # CONFIG_PARTITION_TABLE_TWO_OTA=y
#    # CONFIG_ESP_HTTPS_OTA_ALLOW_HTTP=y
```

## firmware/esp32/main/Kconfig.projbuild
```kconfig
menu "Free Library"
    choice FREE_LIBRARY_LOG_LEVEL
        bool "Default log verbosity"
        default FREE_LIBRARY_LOG_DEFAULT_LEVEL_INFO
        help
            Specify how much output to see in logs by default.
            You can set lower verbosity level at runtime using
            esp_log_level_set function.

            By default, this setting limits which log statements
            are compiled into the program. For example, selecting
            "Warning" would mean that changing log level to "Debug"
            at runtime will not be possible. To allow increasing log
            level above the default at runtime, see the next option.

        config FREE_LIBRARY_LOG_DEFAULT_LEVEL_NONE
            bool "No output"
        config FREE_LIBRARY_LOG_DEFAULT_LEVEL_ERROR
            bool "Error"
        config FREE_LIBRARY_LOG_DEFAULT_LEVEL_WARN
            bool "Warning"
        config FREE_LIBRARY_LOG_DEFAULT_LEVEL_INFO
            bool "Info"
        config FREE_LIBRARY_LOG_DEFAULT_LEVEL_DEBUG
            bool "Debug"
        config FREE_LIBRARY_LOG_DEFAULT_LEVEL_VERBOSE
            bool "Verbose"
    endchoice

    config FREE_LIBRARY_LOG_LEVEL
        int
        default 0 if FREE_LIBRARY_LOG_DEFAULT_LEVEL_NONE
        default 1 if FREE_LIBRARY_LOG_DEFAULT_LEVEL_ERROR
        default 2 if FREE_LIBRARY_LOG_DEFAULT_LEVEL_WARN
        default 3 if FREE_LIBRARY_LOG_DEFAULT_LEVEL_INFO
        default 4 if FREE_LIBRARY_LOG_DEFAULT_LEVEL_DEBUG
        default 5 if FREE_LIBRARY_LOG_DEFAULT_LEVEL_VERBOSE

endmenu
```

## firmware/esp32/sdkconfig.defaults
```kconfig
# configuration per v5.3.1

# FIXME
CONFIG_SNEAKERNET_LOG_DEFAULT_LEVEL_DEBUG=y

# on-target partitions
CONFIG_PARTITION_TABLE_CUSTOM=y
CONFIG_PARTITION_TABLE_CUSTOM_FILENAME="partitions.csv"
CONFIG_PARTITION_TABLE_FILENAME="partitions.csv"
CONFIG_PARTITION_TABLE_MD5=y
CONFIG_ESPTOOLPY_FLASHSIZE_4MB=y
CONFIG_ESPTOOLPY_FLASHSIZE="4MB"

# App Signing
CONFIG_SECURE_SIGNED_ON_BOOT=y
CONFIG_SECURE_SIGNED_ON_UPDATE=y
CONFIG_SECURE_SIGNED_APPS=y
CONFIG_SECURE_SIGNED_APPS_NO_SECURE_BOOT=y
CONFIG_SECURE_SIGNED_APPS_ECDSA_SCHEME=y
CONFIG_SECURE_SIGNED_ON_UPDATE_NO_SECURE_BOOT=y
CONFIG_SECURE_BOOT_BUILD_SIGNED_BINARIES=y
CONFIG_SECURE_BOOT_SIGNING_KEY="~/keystore/sneakernet_firmware.pem"

# if new firmware crashes, reuse the last
BOOTLOADER_APP_ROLLBACK_ENABLE=y

# Network Stack
# set the max sockets allowed by ESP
CONFIG_LWIP_MAX_SOCKETS=16

# optimize transfer rates
CONFIG_LWIP_IRAM_OPTIMIZATION=y
CONFIG_LWIP_EXTRA_IRAM_OPTIMIZATION=y
CONFIG_ESP_WIFI_EXTRA_IRAM_OPT=y
## increase IRAM size to support above options
CONFIG_ESP_SYSTEM_ESP32_SRAM1_REGION_AS_IRAM=y
## reduce IRAM usage to allow above optimizations
# CONFIG_ETH_USE_SPI_ETHERNET=n
# CONFIG_GPTIMER_ISR_HANDLER_IN_IRAM=n
# CONFIG_SPI_SLAVE_ISR_IN_IRAM=n
# CONFIG_ESP_EVENT_POST_FROM_IRAM_ISR=n
# CONFIG_PERIPH_CTRL_FUNC_IN_IRAM=n
# CONFIG_ESP_SPI_BUS_LOCK_ISR_FUNCS_IN_IRAM=n

# TODO suggested by https://docs.espressif.com/projects/esp-idf/en/stable/esp32/api-guides/wifi.html#wifi-buffer-usage
CONFIG_LWIP_TCP_WND_DEFAULT=8192
## RX 
CONFIG_ESP_WIFI_STATIC_RX_BUFFER_NUM=16
CONFIG_ESP32_WIFI_STATIC_RX_BUFFER_NUM=16
CONFIG_ESP_WIFI_RX_BA_WIN=16
CONFIG_ESP32_WIFI_RX_BA_WIN=16
## TX 
# CONFIG_ESP_WIFI_TX_BA_WIN=16
# CONFIG_ESP32_WIFI_TX_BA_WIN=16
# CONFIG_LWIP_TCP_SND_BUF_DEFAULT=8192

# Webserver
# increase allowable header size (required for mobile compatibility)
CONFIG_HTTPD_MAX_REQ_HDR_LEN=1024

# Configure FATFS for SDCard
CONFIG_FATFS_VOLUME_COUNT=1
# support long filenames
CONFIG_FATFS_LFN_HEAP=y
CONFIG_FATFS_MAX_LFN=255
CONFIG_FATFS_API_ENCODING_UTF_8=y

# size optimizations
# CONFIG_BOOTLOADER_COMPILER_OPTIMIZATION_SIZE=y
# CONFIG_COMPILER_OPTIMIZATION_SIZE=y

# Disable unused things to shrink binary
# CONFIG_ESP_HTTPS_SERVER_ENABLE=n
# CONFIG_ESP_WIFI_MBEDTLS_CRYPTO=n
# CONFIG_ESP_WIFI_ENTERPRISE_SUPPORT=n
# CONFIG_WPA_MBEDTLS_CRYPTO=n
# CONFIG_WPA_MBEDTLS_TLS_CLIENT=n
```
